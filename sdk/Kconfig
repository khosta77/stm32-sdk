## sdk/drivers/Kconfig
```kconfig
menu "Drivers"

config STM32_USE_DRIVERS
	bool "Peripheral driver library"
	default n
	help
	  C++20-module driver layer (GPIO, I2C, SPI, UART, DMA, EXTI, flash,
	  CRC, clock) plus the driver.log facility and the portable
	  driver.soft_crc. Required by sensors, storage and the system
	  component framework.

if STM32_USE_DRIVERS

choice
	prompt "Log level ceiling (compile-time)"
	default STM32_LOG_LEVEL_INFO
	help
	  LOG_* calls above the ceiling compile to ((void)0) and their format
	  strings never reach flash. Runtime filtering below the ceiling is
	  still available via driver::log::setLevel.

config STM32_LOG_LEVEL_NONE
	bool "NONE"

config STM32_LOG_LEVEL_ERROR
	bool "ERROR"

config STM32_LOG_LEVEL_WARN
	bool "WARN"

config STM32_LOG_LEVEL_INFO
	bool "INFO"

config STM32_LOG_LEVEL_DEBUG
	bool "DEBUG"

config STM32_LOG_LEVEL_TRACE
	bool "TRACE"

endchoice

config STM32_LOG_LEVEL_NUM
	int
	default 0 if STM32_LOG_LEVEL_NONE
	default 1 if STM32_LOG_LEVEL_ERROR
	default 2 if STM32_LOG_LEVEL_WARN
	default 3 if STM32_LOG_LEVEL_INFO
	default 4 if STM32_LOG_LEVEL_DEBUG
	default 5 if STM32_LOG_LEVEL_TRACE

choice
	prompt "Log backend"
	default STM32_LOG_BACKEND_SEL_NONE
	help
	  Names the sink the build intends to install (both backend modules
	  always compile; templates cost nothing until instantiated). The app
	  picks the matching backend type via the STM32_LOG_BACKEND define.

config STM32_LOG_BACKEND_SEL_NONE
	bool "none"

config STM32_LOG_BACKEND_SEL_ITM
	bool "itm (SWO trace)"

config STM32_LOG_BACKEND_SEL_UART
	bool "uart"

endchoice

config STM32_LOG_BACKEND_NUM
	int
	default 0 if STM32_LOG_BACKEND_SEL_NONE
	default 1 if STM32_LOG_BACKEND_SEL_ITM
	default 2 if STM32_LOG_BACKEND_SEL_UART

endif

endmenu
```

## sdk/rtos/Kconfig
```kconfig
menu "FreeRTOS"

config STM32_USE_FREERTOS
	bool "FreeRTOS kernel"
	default n
	help
	  FreeRTOS-Kernel (heap_4) plus the RAII wrappers in rtos.hpp. The
	  kernel version is pinned in the SDK Docker image and
	  sdk/cmake/stm32_rtos.cmake, not here: it is build infrastructure,
	  not firmware content.

if STM32_USE_FREERTOS

config FREERTOS_TOTAL_HEAP_SIZE
	int "Kernel heap size (bytes, heap_4)"
	default 16384
	range 4096 131072
	help
	  configTOTAL_HEAP_SIZE. All tasks, queues and semaphores created
	  dynamically live here. F407 has 128K SRAM1 + 64K CCM; the linker
	  reports the margin at the end of every build.

config FREERTOS_TICK_RATE_HZ
	int "Tick rate, Hz"
	default 1000
	range 10 10000
	help
	  configTICK_RATE_HZ. The SDK concurrency layer (executor timers,
	  debounce) counts in ticks, so lowering this coarsens Timer
	  resolution accordingly.

config FREERTOS_MAX_PRIORITIES
	int "Number of task priorities"
	default 5
	range 3 32
	help
	  configMAX_PRIORITIES. Valid task priorities are
	  0..FREERTOS_MAX_PRIORITIES-1. SDK demos and templates create tasks
	  at priority 2 and the software-timer task defaults to priority 2 --
	  keep the ceiling above those.

config FREERTOS_MINIMAL_STACK_SIZE
	int "Idle task stack, words"
	default 128
	range 64 4096
	help
	  configMINIMAL_STACK_SIZE (32-bit words, not bytes). Also the static
	  idle-task allocation in sdk/rtos/src/freertos_hooks.cpp.

config FREERTOS_TIMER_TASK_PRIORITY
	int "Software-timer task priority"
	default 2
	range 1 31
	help
	  configTIMER_TASK_PRIORITY. Must be strictly below
	  FREERTOS_MAX_PRIORITIES; genconfig enforces the cross-check at
	  configure time.

config FREERTOS_TIMER_QUEUE_LENGTH
	int "Software-timer command queue length"
	default 10
	range 1 64
	help
	  configTIMER_QUEUE_LENGTH.

config FREERTOS_TIMER_TASK_STACK_DEPTH
	int "Software-timer task stack, words"
	default 256
	range 64 4096
	help
	  configTIMER_TASK_STACK_DEPTH. Historic default is twice the idle
	  stack (2 x 128).

config FREERTOS_CHECK_FOR_STACK_OVERFLOW
	int "Stack overflow checking (0/1/2)"
	default 2
	range 0 2
	help
	  configCHECK_FOR_STACK_OVERFLOW. 0 disables, 1 checks the stack
	  pointer on context switch, 2 additionally pattern-checks the stack
	  tail (slower, catches more).

endif

endmenu
```

## sdk/sensors/Kconfig
```kconfig
menu "Sensors"

config STM32_USE_SENSORS
	bool "Sensor library"
	default n
	depends on STM32_USE_DRIVERS
	help
	  Sensor concepts (IImu/IDisplay/IExternalFlash) and implementations
	  (MPU6050, SSD1306, W25Q32) as templates over the driver bus
	  concepts. Requires the driver library.

endmenu
```

## sdk/storage/Kconfig
```kconfig
menu "Storage"

config STM32_USE_STORAGE
	bool "Flash partition layer"
	default n
	depends on STM32_USE_DRIVERS
	help
	  Declarative flash partition map (#62): a constexpr table validated by
	  a consteval validator, in the spirit of Zephyr's flash_map but without
	  devicetree. Partitions are addressed by name, offsets inside a
	  partition are relative to it, and overlaps, unaligned boundaries and
	  out-of-range entries are compile errors.

	  Works over both the F4 internal flash (driver::IFlash) and an external
	  SPI flash such as the W25Q32; the external adapter states its own
	  structural requirements, so STM32_USE_SENSORS is not required.

endmenu
```

## sdk/system/Kconfig
```kconfig
menu "System framework"

config STM32_USE_SYSTEM
	bool "Component framework"
	default n
	depends on STM32_USE_DRIVERS
	help
	  Zero-vtable component framework: Component concept + bootstrap
	  phases, WorkQueue, and (under FreeRTOS) SingleThreadExecutor, Timer
	  and the signal-bus Channel. Requires the driver library; the
	  executor/timer/channel parts additionally need STM32_USE_FREERTOS.

endmenu
```

## sdk/testing/Kconfig
```kconfig
menu "Testing"

config STM32_USE_TESTING
	bool "On-device unit-test helpers"
	default n
	help
	  Header-only ASSERT_*/EXPECT_* + TestRunner (testing/unit_test.hpp),
	  no exceptions or heap. The programmable mock buses (testing.mock)
	  are a source module the consumer adds to its own CXX_MODULES file
	  set and are not gated here.

endmenu
```
